// SPDX-License-Identifier: (GPL-2.0-or-later OR BSD-3-Clause)
/*
 * Copyright (C) 2024, Octavo Systems - All Rights Reserved
 * 
 */

#define DDR_SIZE	0x20000000 /* 512MB */
#include "stm32mp15-fw-config.dtsi"
